VERSION ""

NS_ :

BS_:

BU_: ECU

BO_ 291 TestMsg: 8 ECU
 SG_ LoByte : 0|8@1+ (1,0) [0|255] "" ECU
 SG_ Volt : 48|16@1+ (0.001,0) [0|65] "V" ECU
 SG_ MotoHi : 55|16@0+ (1,0) [0|65535] "" ECU
 SG_ MotoLo : 7|16@0+ (1,0) [0|65535] "" ECU
 SG_ Mid : 20|12@1+ (1,0) [0|4095] "" ECU
